## conf/layer.conf
```bitbake
# We have a conf and classes directory, add to BBPATH
BBPATH .= ":${LAYERDIR}"

# We have recipes-* directories, add to BBFILES
BBFILES += "${LAYERDIR}/recipes-*/*/*.bb \
            ${LAYERDIR}/recipes-*/*/*.bbappend"

BBFILE_COLLECTIONS += "meta-layer-gui"
BBFILE_PATTERN_meta-layer-gui = "^${LAYERDIR}/"
BBFILE_PRIORITY_meta-layer-gui = "6"

LAYERDEPENDS_meta-layer-gui = "core"
LAYERSERIES_COMPAT_meta-layer-gui = "honister"
```
